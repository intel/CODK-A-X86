## Kconfig
```kconfig
mainmenu "Arduino101_Firmware build configuration"

config PROJECT_PATH
	string
	option env="PROJECT_PATH"

source "bsp/Kconfig"

source "framework/Kconfig"

menu "Services"

source "framework/src/services/Kconfig"
-source "$PROJECT_PATH/services.Kconfig"

endmenu

menu "Test"

config OS_UNIT_TESTS
	bool "OS Unit Tests"
	help
		Caution when selecting this option, as it will dramatically
		increase the output binary size.

config QUARK_DRIVER_TESTS
	bool "Quark driver tests"

config ARC_DRIVER_TESTS
	bool "Arc driver tests"

config ARC_OS_UNIT_TESTS
	bool "Arc OS unit tests"

config GPIO_DRIVER_TESTS
	depends on GPIO
	depends on QUARK_DRIVER_TESTS || ARC_DRIVER_TESTS
	default y
	bool "GPIO driver tests"


endmenu

config EXTERNAL_DIRECTORIES
	string "Directories to include in the build"

-source "$PROJECT_PATH/project.Kconfig"
```

## bsp/Kconfig
```kconfig
source "bsp/src/machine/Kconfig"
source "bsp/src/os/Kconfig"
source "bsp/src/infra/Kconfig"
source "bsp/src/util/Kconfig"
source "bsp/src/drivers/Kconfig"
```

## bsp/src/drivers/Kconfig
```kconfig
menu "Drivers"

config DEVICE_FRAMEWORK
	bool
	select PM #FIXME

source "bsp/src/drivers/aio/Kconfig"
source "bsp/src/drivers/gpio/Kconfig"

source "bsp/src/drivers/mtd/Kconfig"
source "bsp/src/drivers/pm/Kconfig"
source "bsp/src/drivers/rtc/Kconfig"
source "bsp/src/drivers/sba/Kconfig"
source "bsp/src/drivers/spi/Kconfig"
source "bsp/src/drivers/usb/Kconfig"
source "bsp/src/drivers/pwrbtn/Kconfig"
source "bsp/src/drivers/clk/Kconfig"
-source "$PROJECT_PATH/drivers.Kconfig"

endmenu
```

## bsp/src/drivers/aio/Kconfig
```kconfig
config HAS_SOC_COMPARATOR
	bool

config SOC_COMPARATOR
	bool "SOC Comparator driver"
	depends on HAS_SOC_COMPARATOR
	select DEVICE_FRAMEWORK

config TCMD_COMPARATOR
	bool "Comparator Test Command"
	depends on TCMD
	depends on SOC_COMPARATOR
```

## bsp/src/drivers/gpio/Kconfig
```kconfig
config GPIO
	bool

config HAS_GPIO
	bool

config SOC_GPIO
	bool "SOC GPIO Driver"
	depends on HAS_GPIO_SOC
	select GPIO
	select DEVICE_FRAMEWORK

config HAS_GPIO_SOC
	bool
	select HAS_GPIO

config HAS_GPIO_SOC_32
	bool
	select HAS_GPIO_SOC

config HAS_GPIO_SOC_AON
	bool
	select HAS_GPIO_SOC

if SOC_GPIO

menu "SOC GPIO active banks"

config SOC_GPIO_32
	bool "GPIO 32"
	depends on HAS_GPIO_SOC_32

config SOC_GPIO_AON
	bool "GPIO AON"
	depends on HAS_GPIO_SOC_AON

endmenu

endif

config HAS_GPIO_SS
	bool
	select HAS_GPIO

config SS_GPIO
	bool "GPIO SS driver"
	depends on HAS_GPIO_SS
```

## bsp/src/drivers/mtd/Kconfig
```kconfig
config HAS_FLASH
	bool

config HAS_FLASH_SOC
	bool
	select HAS_FLASH

config SOC_FLASH
	bool "SOC Flash driver"
	depends on HAS_FLASH_SOC

config HAS_SPI_FLASH
	bool
	select HAS_FLASH

config SPI_FLASH
	bool

config SPI_FLASH_INTEL_QRK
	bool
	depends on HAS_INTEL_QRK_SPI
	select SBA
	select INTEL_QRK_SPI
	select DEVICE_FRAMEWORK
	select WAKELOCK

config SPI_FLASH_W25Q16DV
	bool "SPI NOR Flash Winbond W25Q16DV on Intel QRK"
	depends on HAS_SPI_FLASH
	select SPI_FLASH_INTEL_QRK

config SPI_FLASH_MX25U12835F
	bool "SPI NOR Flash Macronix MX25U12835F on Intel QRK"
	depends on HAS_SPI_FLASH
	select SPI_FLASH_INTEL_QRK

config HAS_ROM_SOC
	bool

config SOC_ROM
	bool "SOC Rom driver"
	depends on HAS_ROM_SOC
	select WAKELOCK
```

## bsp/src/drivers/pm/Kconfig
```kconfig
config PM
	bool

config HAS_USB_PM
	bool

config WAKELOCK
	bool "Wakelock engine"
	help
		Generic Wakelock implementation for device drivers

config USB_PM
	bool "USB cable detection driver"
	depends on HAS_USB_PM
	depends on SOC_GPIO_AON || SOC_COMPARATOR
	select LIST

config USB_PM_SUSPEND_BLOCKERS
	bool "USB cable detection suspend blocker"
	default y
	depends on USB_PM
	help
		Prevent deepsleep mode if USB cable is plugged.

config NORDIC_SUSPEND_BLOCKER_PM
	bool "Nordic suspend blocker driver"
	depends on HAS_NORDIC
	depends on PM
	depends on SOC_GPIO_AON

config HAS_PM_PUPDR
	bool

config PM_PUPDR
	bool "Power-Up Power-Down driver"
	depends on HAS_PM_PUPDR
	select DEVICE_FRAMEWORK
	select INTEL_QRK_RTC if HAS_INTEL_QRK_RTC
	select WAKELOCK
	select LIST

config HAS_BOARD_SHUTDOWN
	bool

config BOARD_SHUTDOWN
	bool "Call board specific shutdown"
	depends on HAS_BOARD_SHUTDOWN
	depends on PM_PUPDR
	default y

config DEEPSLEEP
	bool "Allow deep sleep in selected SoC."
	depends on PM_PUPDR

config DEEPSLEEP_WHEN_IDLE
	bool "Attempt to enter deep sleep when cpu is in idle task"
	default n
	depends on DEEPSLEEP
```

## bsp/src/drivers/pwrbtn/Kconfig
```kconfig
config PWRBTN
	bool

config HAS_PWRBTN
	bool "Power Button"

config PWRBTN_GPIO
	bool "Power button GPIO module"
	select SERVICES_QRK_SE_GPIO
```

## bsp/src/drivers/rtc/Kconfig
```kconfig
config RTC
	bool

config HAS_INTEL_QRK_RTC
	bool

config HAS_INTEL_QRK_AON_PT
	bool

config INTEL_QRK_RTC
	bool "Intel Quark RTC driver"
	depends on HAS_INTEL_QRK_RTC
	select RTC
	select DEVICE_FRAMEWORK
	select CLK_SYSTEM
	select WAKELOCK

config INTEL_QRK_AON_PT
	bool "Intel Quark Always ON Periodic Timer (AONPT) driver"
	depends on HAS_INTEL_QRK_AON_PT
	select DEVICE_FRAMEWORK
```

## bsp/src/drivers/sba/Kconfig
```kconfig
config SBA
	bool
	select DEVICE_FRAMEWORK
	select CLK_SYSTEM
	select WAKELOCK
	select LIST
```

## bsp/src/drivers/spi/Kconfig
```kconfig
config SPI
	bool

config HAS_INTEL_QRK_SPI
	bool

config INTEL_QRK_SPI
	bool "Intel Quark SPI driver"
	depends on HAS_INTEL_QRK_SPI
	select SPI
	select SBA if TCMD
	select CLK_SYSTEM

config HAS_SS_SPI
	bool

config SS_SPI
	bool "SS SPI driver"
	depends on HAS_SS_SPI
	select SPI
	select SBA if TCMD
	select CLK_SYSTEM
```

## bsp/src/drivers/usb/Kconfig
```kconfig
menu "USB"

config USB
	bool

config HAS_USB
	bool

config USB_SHARED_INTERFACE
	bool
	depends on QUARK_SE && HAS_USB

config USB_PRODUCT_ID
	hex "USB Product ID"
	default 0x0a99
	depends on USB

config USB_VENDOR_ID
	hex "USB Vendor ID"
	default 0x8087
	depends on USB

choice
	prompt "USB Function driver"
	optional
	depends on HAS_USB

config USB_ACM
	bool "ACM"
	select USB
	select WORKQUEUE

endchoice

config ACM_DUAL
	bool "Dual mode"
	depends on USB_ACM

endmenu
```

## bsp/src/infra/Kconfig
```kconfig
menu "Infra"

config IPC
	bool

config HAS_SHARED_MEM
        bool

config HAS_IPC
	bool

menuconfig PORT
	bool "Port based communications"
	select LOG
	select LIST
	help
	Asynchronous messaging mechanism based on queues.

config PORT_MULTI_CPU_SUPPORT
	bool "Support communications between multiple CPUs"
	default y
	depends on PORT
	depends on HAS_IPC
	select IPC if HAS_IPC
	help
	Allow messages to be exchanged between cores.

config PORT_IS_MASTER
    bool "Act as the master for port communications"
    depends on PORT

config PANIC
	bool "Panic handling"

config PANIC_ON_BUS_ERROR
	bool "Panic on bus error"
	depends on PANIC
	help
	Panic when a bus error is catched on the bus

config PANIC_DUMP_ON_REBOOT
	bool "Panic dump copy to NVM after reboot"
	depends on PANIC
	depends on NORDIC
	help
	Copy panic dump from RAM to NVM just after master core reset

menuconfig LOG
	bool "Logging support"

config LOG_MULTI_CPU_SUPPORT
	bool "Multi-CPU log support"
	depends on LOG
	help
	When this option is active, logs will be routed using IPC from slaves CPUs
	to a single master CPU.

choice
	prompt "Master/Slave"
	depends on LOG_MULTI_CPU_SUPPORT
	default LOG_SLAVE if QUARK_SE_NORDIC

config LOG_MASTER
	bool "Master"
	help
	Master receives log messages from all slaves CPUs.

config LOG_SLAVE
	bool "Slave"
	help
	Slave send log messages to master.

endchoice


choice
	prompt "Message logging implementation"
	depends on LOG

config LOG_PRINTK
	bool "Simple printk log implementation"
	depends on LOG_MASTER || !LOG_MULTI_CPU_SUPPORT
	help
	A simple log implementation using an externally provided printk function.

config LOG_PRINTF
	bool "Simple printf log implementation"
	depends on LOG_MASTER || !LOG_MULTI_CPU_SUPPORT
	help
	A simple log implementation using an externally provided printf function.

config LOG_CBUFFER
	bool "Circular Buffer Log implementation"
	help
	A log implementation using a circular log buffer and a dedicated
	low-priority log task doing the actual flush.

config LOG_LOCAL
	bool "Local implementation of message logging"
	help
	The project implements its own message logging function.

endchoice

config LOG_CBUFFER_SIZE
	int "Circular Log Buffer Size (bytes)"
	default 1024
	depends on LOG_CBUFFER
	help
	The size of the Circular Log Buffer (in bytes)

config CBUFFER_STORAGE
	bool "Circular Buffer Storage"
	help
	A generic circular buffer module to store fixed or variable element size.

config FACTORY_DATA
	bool "Add support for factory data insertion"

config VERSION
	bool "Binary version header"
	select LOG
	default y

config LOG_BACKEND_USB
	bool "Log over USB"
	depends on LOG
	depends on USB_ACM
	help
	When enabled logging is over USB, when disabled logging is over UART.



endmenu
```

## bsp/src/machine/Kconfig
```kconfig
config MACHINE_INCLUDE_PATH
	string
	help
		The directory where the mandatory machine.h file for this machine is
		located. It is automatically added to the include search path.

# Board selection
source "bsp/src/machine/board/Kconfig"

# SoC features (can only be selected automatically by the board)
source "bsp/src/machine/soc/quark_se/Kconfig"

config HAS_ARC
	bool

config HAS_QUARK
	bool

config BLE_LPM
	bool "Low Power Mode"

config QEMU_X86
	bool "Qemu X86"
	depends on HAS_ARC || HAS_QUARK

config HAS_NORDIC
	bool
	select HAS_IPC

choice
	prompt "Core"
	depends on HAS_ARC || HAS_QUARK || HAS_NORDIC

config ARC
	bool "ARC"
	depends on HAS_ARC

config QUARK
	bool "Quark"
	depends on HAS_QUARK

config NORDIC
	bool "Nordic"
	depends on HAS_NORDIC

endchoice

config CORE_NAME
	string
	default "arc" if ARC
	default "quark" if QUARK
	default "nordic" if NORDIC

comment "Define a proper Board Configuration to enable the Core menu"
	depends on !HAS_ARC && !HAS_QUARK && !HAS_NORDIC
```

## bsp/src/machine/board/Kconfig
```kconfig
choice
	prompt "Board"

source "bsp/src/machine/board/quark_se_ctb/Kconfig"
source "bsp/src/machine/board/quark_se_app/Kconfig"

-source "$PROJECT_PATH/boards.Kconfig"

endchoice
```

## bsp/src/machine/board/quark_se_app/Kconfig
```kconfig
config BOARD_QUARK_SE_APP
	bool "Quark_SE Platform (APP)"
	# List all available hardware for this board
	select QUARK_SE
	select HAS_NORDIC
	select HAS_SPI_FLASH if QUARK
	select HAS_LED if QUARK
	select HAS_HAPTIC if QUARK
	# Select appropriate driver if a feature is activated
	select SPI_FLASH_MX25U12835F if (SPI_FLASH && QUARK)
	select SOC_LED if (LED && QUARK)
	select DRV2605 if (HAPTIC && QUARK)

if BOARD_QUARK_SE_APP

# Set the default for this option, which is already defined in the Kconfig above
config MACHINE_INCLUDE_PATH
	string
	default     "$(T)/firmware/bsp/include/machine/board/quark_se_ctb/$(CONFIG_CORE_NAME)/"

endif
```

## bsp/src/machine/board/quark_se_ctb/Kconfig
```kconfig
config BOARD_QUARK_SE_CTB
	bool "Curie Test Board (CTB)"
	select QUARK_SE_CURIE

if BOARD_QUARK_SE_CTB

# Set the default for this option, which is already defined in the Kconfig above
config MACHINE_INCLUDE_PATH
	string
	default     "$(T)/arduino101_firmware/bsp/include/machine/board/quark_se_ctb/$(CONFIG_CORE_NAME)/"

# internal regulators are used in ctb board
config QUARK_SE_DISABLE_INTERNAL_VREG
	bool
	default n

endif
```

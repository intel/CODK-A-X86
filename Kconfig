## bsp/src/machine/soc/quark_se/Kconfig
```kconfig
config QUARK_SE_CURIE
	bool
	select QUARK_SE
	select HAS_NORDIC
	select HAS_BATTERY

config QUARK_SE_DISABLE_INTERNAL_VREG
	bool
	default y
	depends on QUARK_SE_CURIE

config QUARK_SE_SWITCH_INTERNAL_OSCILLATOR
	bool
	default y
	depends on QUARK_SE_CURIE

config QUARK_SE
	bool
	select HAS_ARC
	select HAS_QUARK

# Hardware features supported by Quark_SE based platforms

# ARC | Quark
config QUARK_SE_COMMON
	bool
	depends on QUARK_SE
	default y if ARC || QUARK
	select HAS_SOC_COMPARATOR
	select HAS_GPIO_SOC_32
	select HAS_GPIO_SOC_AON
	select HAS_INTEL_QRK_I2C
	select HAS_INTEL_QRK_SPI
	select HAS_PVP
	select HAS_IPC
	select HAS_SHARED_MEM
	# select only if nordic is available and PM is used
	# on the same core on which gpio aon is compiled
	select NORDIC_SUSPEND_BLOCKER_PM if PM && HAS_NORDIC && SOC_GPIO_AON

# ARC Only
config QUARK_SE_ARC
	bool
	depends on QUARK_SE
	default y if ARC
	select HAS_USB_PM if BOARD_QUARK_SE_APP
	select HAS_PM_PUPDR
	select HAS_GPIO_SS
	select HAS_SS_ADC
	select HAS_SS_I2C
	select HAS_SS_SPI
	select HAS_BMI160_I2C if BOARD_QUARK_SE_APP
	select HAS_BMI160_SPI if QUARK_SE_CURIE

# Quark Only
config QUARK_SE_QUARK
	bool
	depends on QUARK_SE
	default y if QUARK
	select HAS_IPC_UART
	select IPC_UART_NS16550 if IPC_UART
	select HAS_FLASH_SOC
	select HAS_ROM_SOC
	select HAS_USB_PM if QUARK_SE_CURIE
	select HAS_PM_PUPDR
	select HAS_INTEL_QRK_PWM
	select HAS_INTEL_QRK_RTC
	select HAS_INTEL_QRK_AON_PT
	select HAS_UART_NS16550
	select HAS_USB
	select HAS_INTEL_QRK_WDT
	# Select appropriate driver if feature is selected
	select USB_SHARED_INTERFACE if USB

# Nordic only
config QUARK_SE_NORDIC
	bool
	depends on QUARK_SE
	default y if NORDIC
	select HAS_IPC_UART
	select BLE_LPM


menu "Quark_SE"
	depends on QUARK_SE

choice
	prompt "Panic implementation"
	depends on PANIC

config QUARK_SE_PANIC_DEFAULT
	bool "Default"
	help
		Default implementation includes hardware exceptions and panic
		propagation.

config QUARK_SE_PANIC_CUSTOM
	bool "Custom"
	help
		Selecting this allows an Quark_SE based project to use a different
		panic implementation.

endchoice

config QUARK_SE_PANIC_DEBUG
	bool "Panic debug logs"
	default y
	depends on QUARK_SE_PANIC_DEFAULT
	help
		Parse and print panic dumps for ARC/QRK cores before reset.

config QUARK_SE_PINMUX_SETUP
	bool "Pinmux Setup"
	default y if QUARK_SE_QUARK
	depends on QUARK_SE
	help
		Provides the default pinmux configuration for Quark_SE. You
		should call pinmux_config() to setup the pinmux.
		Note that Quark boots first, so it is better if that is the
		core that implements this functionality.

config QUARK_SE_USB_SETUP
	bool "Quark_SE specific USB initialization"
	default y
	depends on QUARK_SE
	depends on USB
	depends on SOC_GPIO_32
	help
		Provides USB platform initialization for Quark_SE.

config QUARK_SE_UPTIME
	bool "Quark_SE uptime implementation"
	default y
	depends on QUARK_SE
	help
		Provides an implementation for get_uptime_32k() and
		get_uptime() for Quark_SE platform.

config OS_ZEPHYR_LIBC_HOOKS
	bool "LibC Hooks for Zephyr's LibC"
	default y
	depends on OS_ZEPHYR_MICROKERNEL
	help
		Provides basic stubs implementations for kill, getpid and sbrk
		functions needed by Zephyr's LibC.

menu "Memory mapping"

config QUARK_SE_ARC_RAM_SIZE
	hex "ARC RAM size"
	default 0x6000

endmenu

if QUARK_SE_QUARK
menu "Quark_SE Quark"

config QUARK_SE_QUARK_INT_STUBS
	bool "Interrupt Table for Quark on Zephyr"
	default y
	depends on OS_ZEPHYR
	depends on QUARK_SE_QUARK
	help
		Provides static interrupt table.

config QUARK_SE_QUARK_LOG_BACKEND_UART
	bool "UART log backend for Quark on Zephyr"
	default y
	depends on OS_ZEPHYR
	depends on QUARK_SE_QUARK
	help
		Provides a logger backend that uses UART1.

config QUARK_SE_QUARK_SOC_SETUP
	bool "SoC Initialization for Quark on Zephyr"
	default y
	depends on QUARK_SE_QUARK_INT_STUBS
	depends on OS_ZEPHYR
	depends on QUARK_SE_QUARK
	help
		Provides SoC initialization.

config QUARK_SE_QUARK_SOC_CONFIG
	bool "SoC configuration for Quark"
	default y
	depends on QUARK_SE_QUARK
	depends on DEVICE_FRAMEWORK
	help
		Device tree implementation as seen on Quark_SE by Quark
		core. Provides a function called init_all_devices() to
		initialize the statically compiled device tree.

endmenu
endif

if QUARK_SE_ARC
menu "Quark_SE Arc"

config QUARK_SE_ARC_SOC_SETUP
	bool "SoC Initialization for ARC on Zephyr"
	default y
	depends on OS_ZEPHYR
	depends on QUARK_SE_ARC
	help
		Provides SoC initialization.

config QUARK_SE_ARC_SOC_CONFIG
	bool "SoC configuration for ARC"
	default y
	depends on QUARK_SE_ARC
	depends on DEVICE_FRAMEWORK
	help
		Device tree implementation as seen on Quark_SE by ARC core.
		Provides a function called init_all_devices() to initialize the
		statically compiled device tree.

endmenu
endif


config QUARK_SE_QUARK_DEEPSLEEP_WHEN_IDLE
	bool
	default y if DEEPSLEEP_WHEN_IDLE
	depends on DEEPSLEEP_WHEN_IDLE
	depends on HAS_INTEL_QRK_AON_PT
	select INTEL_QRK_AON_PT
	depends on OS_ZEPHYR

endmenu
```

## bsp/src/os/Kconfig
```kconfig
menu "Operating System"

choice
	prompt "Operating System Abstraction"

config OS_NONE
	bool "None"

config OS_LINUX
	bool "Linux"
	select LIST

config OS_ZEPHYR
	bool "Zephyr"
	select LIST

config OS_NORDIC
	bool "Nordic"
	select LIST

endchoice

config MEM_POOL_DEF_PATH
	string "The path to the memory pool definitions"

source "bsp/src/os/zephyr/Kconfig"

endmenu
```

## bsp/src/os/zephyr/Kconfig
```kconfig
if OS_ZEPHYR

menu "Zephyr OS"

choice
	prompt "Kernel"

config OS_ZEPHYR_NANOKERNEL
	bool "Nano"

config OS_ZEPHYR_MICROKERNEL
	bool "Micro"

endchoice

config OS_ZEPHYR_MDEF
	string "Main application configuration file"
	default "main.mdef"

config ZEPHYR_CONF_FILE
        string "Zephyr configuration file path"
        default "prj-Intel.conf"

config BALLOC_STATISTICS
	bool "Collect balloc usage statistics"
	help
	Collect balloc usage statistics and add a test command to display them

config BALLOC_STATISTICS_TRACK_OWNER
	bool "Tracks memory block owners"
	depends on BALLOC_STATISTICS

endmenu

endif
```

## bsp/src/util/Kconfig
```kconfig
menu "Utility libraries"

config WORKQUEUE
	bool "An OS agnostic workqueue implementation"
	select LOG

config CUNIT_TESTS
	bool "Unit Tests Utils"
	select LOG

config LIST
	bool "Generic list handler"

endmenu
```

## external/zephyr/arch/arc/platforms/quark_se-arc/Kconfig
```kconfig
# bsp.kconf - Quark_SE ARC BSP configuration options

#
# Copyright (c) 2014 Wind River Systems, Inc.
#
# Redistribution and use in source and binary forms, with or without
# modification, are permitted provided that the following conditions are met:
#
# 1) Redistributions of source code must retain the above copyright notice,
# this list of conditions and the following disclaimer.
#
# 2) Redistributions in binary form must reproduce the above copyright notice,
# this list of conditions and the following disclaimer in the documentation
# and/or other materials provided with the distribution.
#
# 3) Neither the name of Wind River Systems nor the names of its contributors
# may be used to endorse or promote products derived from this software without
# specific prior written permission.
#
# THIS SOFTWARE IS PROVIDED BY THE COPYRIGHT HOLDERS AND CONTRIBUTORS "AS IS"
# AND ANY EXPRESS OR IMPLIED WARRANTIES, INCLUDING, BUT NOT LIMITED TO, THE
# IMPLIED WARRANTIES OF MERCHANTABILITY AND FITNESS FOR A PARTICULAR PURPOSE
# ARE DISCLAIMED. IN NO EVENT SHALL THE COPYRIGHT HOLDER OR CONTRIBUTORS BE
# LIABLE FOR ANY DIRECT, INDIRECT, INCIDENTAL, SPECIAL, EXEMPLARY, OR
# CONSEQUENTIAL DAMAGES (INCLUDING, BUT NOT LIMITED TO, PROCUREMENT OF
# SUBSTITUTE GOODS OR SERVICES; LOSS OF USE, DATA, OR PROFITS; OR BUSINESS
# INTERRUPTION) HOWEVER CAUSED AND ON ANY THEORY OF LIABILITY, WHETHER IN
# CONTRACT, STRICT LIABILITY, OR TORT (INCLUDING NEGLIGENCE OR OTHERWISE)
# ARISING IN ANY WAY OUT OF THE USE OF THIS SOFTWARE, EVEN IF ADVISED OF THE
# POSSIBILITY OF SUCH DAMAGE.
#

config PLATFORM
        string
        default quark_se-arc
        help
        This option holds the directory name used by sysgen to identify
        the location of the config1p.vpf file and is used by the build system
        to locate the correct linker file.

config NUM_IRQ_PRIO_LEVELS
	# This processor supports only 2 priority levels:
	# 0 for Fast Interrupts (FIRQs) and 1 for Regular Interrupts (IRQs).
	default 2

config NUM_REGULAR_IRQ_PRIO_LEVELS
	# This processor supports only 1 Regular Interrupt priority level (1).
	default 1

config  NUM_IRQS
	# must be >= the highest interrupt number used
	default 17


menu "Quark_SE BSP Options"

config VERSION_HEADER
        bool "Add version header"
        default y
        depends on PLATFORM_QUARK_SE_ARC
        help
        Adds a version header

config TEST_COMMAND
        bool "Add test commands"
        default y
        depends on PLATFORM_QUARK_SE_ARC
        help
        Adds a version header

config	SYS_CLOCK_HW_CYCLES_PER_SEC
	default 32000000

config RAM_START
	prompt "RAM start address"
	hex
	default 0x4000 if NSIM
	default 0xa8000000

config RAM_SIZE
	prompt "RAM size (in bytes)"
	hex
	default 0x4000 if NSIM
	default 0x14000

config NSIM
	prompt "Running on the MetaWare nSIM simulator"
	bool
	default n
	help
	  For running on nSIM simulator.

	  a) Uses non-XIP to run in RAM.
	  b) Linked at address 0x4000 with 0x4000 of RAM so that it works with
	     a pc_size of 16 (default).
	  c) Sets the entry point to __reset, since it seems nSIM ignores the
	     reset vector when starting (??).

endmenu
```

## external/zephyr/arch/x86/platforms/mint_valley/Kconfig
```kconfig
#
#
# Copyright (c) 2016, Intel Corporation
# All rights reserved.
# 
# Redistribution and use in source and binary forms, with or without
# modification, are permitted provided that the following conditions are met:
# 
# 1. Redistributions of source code must retain the above copyright notice,
# this list of conditions and the following disclaimer.
# 
# 2. Redistributions in binary form must reproduce the above copyright notice,
# this list of conditions and the following disclaimer in the documentation
# and/or other materials provided with the distribution.
# 
# 3. Neither the name of the copyright holder nor the names of its
# contributors may be used to endorse or promote products derived from this
# software without specific prior written permission.
# 
# THIS SOFTWARE IS PROVIDED BY THE COPYRIGHT HOLDERS AND CONTRIBUTORS "AS IS"
# AND ANY EXPRESS OR IMPLIED WARRANTIES, INCLUDING, BUT NOT LIMITED TO, THE
# IMPLIED WARRANTIES OF MERCHANTABILITY AND FITNESS FOR A PARTICULAR PURPOSE
# ARE DISCLAIMED. IN NO EVENT SHALL THE COPYRIGHT HOLDER OR CONTRIBUTORS BE
# LIABLE FOR ANY DIRECT, INDIRECT, INCIDENTAL, SPECIAL, EXEMPLARY, OR
# CONSEQUENTIAL DAMAGES (INCLUDING, BUT NOT LIMITED TO, PROCUREMENT OF
# SUBSTITUTE GOODS OR SERVICES; LOSS OF USE, DATA, OR PROFITS; OR BUSINESS
# INTERRUPTION) HOWEVER CAUSED AND ON ANY THEORY OF LIABILITY, WHETHER IN
# CONTRACT, STRICT LIABILITY, OR TORT (INCLUDING NEGLIGENCE OR OTHERWISE)
# ARISING IN ANY WAY OUT OF THE USE OF THIS SOFTWARE, EVEN IF ADVISED OF THE
# POSSIBILITY OF SUCH DAMAGE.
#
#
#


config PLATFORM
	string
	default mint_valley
	help
	This option holds the directory name used by sysgen to identify
	the location of the config1p.vpf file and is used by the build system
	to locate the correct linker file.

config  LOAPIC_TIMER_FREQ
	default 32000000

config  SYS_CLOCK_HW_CYCLES_PER_SEC
	default 32000000

config  PHYS_LOAD_ADDR
	default 0x00180000 if XIP
	default 0x00280000 if !XIP


config PHYS_SRAM_ADDR
	hex "Physical SRAM address"
	default 0x00280000
	help
	This option specifies the physical SRAM address of this Soc.

config MVIC_LOAPIC_TIMER_VEC
	hex "Vector for MVIC LVT Timer."
	help
	Mint Valley Interrupt Controller (MVIC) LVT Timer vector.
```

## external/zephyr/arch/x86/platforms/quark_se-x86/Kconfig
```kconfig
# Kconfig - Quark_SE configuration options

#
#
# Copyright (c) 2016, Intel Corporation
# All rights reserved.
# 
# Redistribution and use in source and binary forms, with or without
# modification, are permitted provided that the following conditions are met:
# 
# 1. Redistributions of source code must retain the above copyright notice,
# this list of conditions and the following disclaimer.
# 
# 2. Redistributions in binary form must reproduce the above copyright notice,
# this list of conditions and the following disclaimer in the documentation
# and/or other materials provided with the distribution.
# 
# 3. Neither the name of the copyright holder nor the names of its
# contributors may be used to endorse or promote products derived from this
# software without specific prior written permission.
# 
# THIS SOFTWARE IS PROVIDED BY THE COPYRIGHT HOLDERS AND CONTRIBUTORS "AS IS"
# AND ANY EXPRESS OR IMPLIED WARRANTIES, INCLUDING, BUT NOT LIMITED TO, THE
# IMPLIED WARRANTIES OF MERCHANTABILITY AND FITNESS FOR A PARTICULAR PURPOSE
# ARE DISCLAIMED. IN NO EVENT SHALL THE COPYRIGHT HOLDER OR CONTRIBUTORS BE
# LIABLE FOR ANY DIRECT, INDIRECT, INCIDENTAL, SPECIAL, EXEMPLARY, OR
# CONSEQUENTIAL DAMAGES (INCLUDING, BUT NOT LIMITED TO, PROCUREMENT OF
# SUBSTITUTE GOODS OR SERVICES; LOSS OF USE, DATA, OR PROFITS; OR BUSINESS
# INTERRUPTION) HOWEVER CAUSED AND ON ANY THEORY OF LIABILITY, WHETHER IN
# CONTRACT, STRICT LIABILITY, OR TORT (INCLUDING NEGLIGENCE OR OTHERWISE)
# ARISING IN ANY WAY OUT OF THE USE OF THIS SOFTWARE, EVEN IF ADVISED OF THE
# POSSIBILITY OF SUCH DAMAGE.
#
#
#

config PLATFORM
        string
        default quark_se-x86
        help
        This option holds the directory name used by sysgen to identify
        the location of the config1p.vpf file and is used by the build system
        to locate the correct linker file.

choice
        prompt "Board Type"
        depends on PLATFORM_QUARK_SE_X86
        default BOARD_CTB

        config BOARD_CTB
        bool "CTB - Curie Platform"

        config BOARD_APP
        bool "APP - Quark_SE Platform"

        config BOARD_AAE
        bool "AAE - Quark_SE Arduino101"
endchoice

config  LOAPIC_TIMER_FREQ
        default 32000000

config	SYS_CLOCK_HW_CYCLES_PER_SEC
	default 32000000

config  PHYS_LOAD_ADDR
	default 0x40010000 if XIP
	default 0xA8000000 if !XIP


config PINMUX_BASE
        default 0xB0800930
	depends on PINMUX

config PINMUX_NUM_PINS
	default 69
	depends on PINMUX

config DW_AIO_COMPARATOR_BASE_ADDR
	hex
	depends on DW_AIO_COMPARATOR
	default 0xb0800300

config VERSION_HEADER
	bool "Add version header"
	default y
	depends on PLATFORM_QUARK_SE_X86
	help
	Adds a version header



config TEST_COMMAND
	bool "Add test commands"
	default y
	depends on PLATFORM_QUARK_SE_X86
	help
	Adds a version header

config ARC_INIT
	bool "Quark_SE ARC Kickoff"
	default n
	help
	Allows x86 processor to kickoff the ARC slave processor.

config ARC_INIT_DEBUG
	bool "Allows the usage of GDB with the ARC processor."
	depends on ARC_INIT
	default n
	help
	This option will stop the master processor from kicking-off
	the ARC slave processor. This will allow GDB to halt an
	engage the ARC processor.
```

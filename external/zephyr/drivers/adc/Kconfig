## external/zephyr/drivers/adc/Kconfig
```kconfig
# Kconfig - ADC configuration options

#
#
# Copyright (c) 2016, Intel Corporation
# All rights reserved.
# 
# Redistribution and use in source and binary forms, with or without
# modification, are permitted provided that the following conditions are met:
# 
# 1. Redistributions of source code must retain the above copyright notice,
# this list of conditions and the following disclaimer.
# 
# 2. Redistributions in binary form must reproduce the above copyright notice,
# this list of conditions and the following disclaimer in the documentation
# and/or other materials provided with the distribution.
# 
# 3. Neither the name of the copyright holder nor the names of its
# contributors may be used to endorse or promote products derived from this
# software without specific prior written permission.
# 
# THIS SOFTWARE IS PROVIDED BY THE COPYRIGHT HOLDERS AND CONTRIBUTORS "AS IS"
# AND ANY EXPRESS OR IMPLIED WARRANTIES, INCLUDING, BUT NOT LIMITED TO, THE
# IMPLIED WARRANTIES OF MERCHANTABILITY AND FITNESS FOR A PARTICULAR PURPOSE
# ARE DISCLAIMED. IN NO EVENT SHALL THE COPYRIGHT HOLDER OR CONTRIBUTORS BE
# LIABLE FOR ANY DIRECT, INDIRECT, INCIDENTAL, SPECIAL, EXEMPLARY, OR
# CONSEQUENTIAL DAMAGES (INCLUDING, BUT NOT LIMITED TO, PROCUREMENT OF
# SUBSTITUTE GOODS OR SERVICES; LOSS OF USE, DATA, OR PROFITS; OR BUSINESS
# INTERRUPTION) HOWEVER CAUSED AND ON ANY THEORY OF LIABILITY, WHETHER IN
# CONTRACT, STRICT LIABILITY, OR TORT (INCLUDING NEGLIGENCE OR OTHERWISE)
# ARISING IN ANY WAY OUT OF THE USE OF THIS SOFTWARE, EVEN IF ADVISED OF THE
# POSSIBILITY OF SUCH DAMAGE.
#
#

#
# ADC options
#
menuconfig ADC
	bool
	prompt "ADC Driver"
	default n
	help
	Enable the ADC driver for the platform

config DW_ADC
	bool "ARC Designware Driver"
	depends on ADC && ARC
	default n
	help
	Enable the driver implementation of the Designware ADC IP.

choice
	prompt "Input Mode"
	depends on ADC
	default ADC_SINGLE_ENDED
	help
	ADC input mode: single ended or differential.

config ADC_SINGLE_ENDED
	bool "Single ended"

config ADC_DIFFERENTIAL
	bool "Differential"

endchoice

config ADC_INPUT_MODE
	int
	depends on ADC
	default 0 if ADC_SINGLE_ENDED
	default 1 if ADC_DIFFERENTIAL

choice
	prompt "Output Mode"
	depends on ADC
	default ADC_SERIAL
	help
	ADC output mode: parallel or serial.

config ADC_SERIAL
	bool "Serial"

config ADC_PARALLEL
	bool "Parallel"

endchoice

config ADC_OUTPUT_MODE
	int
	depends on ADC
	default 0 if ADC_SERIAL
	default 1 if ADC_PARALLEL

choice
	prompt "Sequence Mode"
	depends on ADC
	default ADC_SINGLESHOT
	help
	ADC sequence mode - single run/repetitive

config ADC_SINGLESHOT
	bool "Single Ended"

config ADC_REPETITIVE
	bool "Differential"

endchoice

config ADC_SEQ_MODE
	int
	depends on ADC
	default 0 if ADC_SINGLESHOT
	default 1 if ADC_REPETITIVE

choice
	prompt "Capture Mode"
	depends on ADC
	default ADC_RISING_EDGE
	help
	ADC controller capture mode:
	by rising or falling edge of adc_clk

config ADC_RISING_EDGE
	bool "Rising Edge"

config ADC_FALLING_EDGE
	bool "Falling Edge"

endchoice

config ADC_CAPTURE_MODE
	int
	depends on ADC
	default 0 if ADC_RISING_EDGE
	default 1 if ADC_FALLING_EDGE

choice
	prompt "Sample Width"
	depends on ADC
	default ADC_WIDTH_6_BIT
	help
	ADC sample width

config ADC_WIDTH_6_BIT
	bool "6 Bit Width"

config ADC_WIDTH_8_BIT
	bool "8 Bit Width"

config ADC_WIDTH_10_BIT
	bool "10 Bit Width"

config ADC_WIDTH_12_BIT
	bool "12 Bit Width"

endchoice

config ADC_WIDTH
	int
	depends on ADC
	default 0 if ADC_WIDTH_6_BIT
	default 1 if ADC_WIDTH_8_BIT
	default 2 if ADC_WIDTH_10_BIT
	default 3 if ADC_WIDTH_12_BIT

config ADC_SERIAL_DELAY
	int "Serial Delay"
	depends on ADC
	default 1
	help
	Number of ADC clock ticks that the first bit of
	the serial output is delayed after the conversion
	has started.

config ADC_CLOCK_RATIO
	int "Clock Ratio"
	depends on ADC
	default 1024
	help
	ADC Clock Ratio
```

## external/zephyr/drivers/rtc/Kconfig
```kconfig
config DW_RTC
	bool "Build Designware RTC Driver"
	default n
	help
	Designware RTC driver.
```

## external/zephyr/drivers/wdt/Kconfig
```kconfig
config DW_WDT
	bool "Enable DesignWare Watchdog"
	default n
	help
	Enable watchdog timer.
```

## framework/Kconfig
```kconfig
menuconfig CFW
	bool "Component Framework for services"
	select PORT
	select IPC if HAS_IPC
	select PANIC
	select CFW_CLIENT
	select CFW_SERVICE

if CFW

source "framework/src/cfw/Kconfig"


endif
```

## framework/src/cfw/Kconfig
```kconfig
choice
	prompt "Master/Proxy"
	depends on CFW

config CFW_MASTER
	bool "Master"
	select LIST
	select PORT_IS_MASTER
	help
	The Master Framework node is in charge of dispatching service requests and
	responses.

config CFW_PROXY
	bool "Proxy"
	select LIST
	help
	A Proxy node registers its services to the Master node and honours requests
	received from the Master.

endchoice


config CFW_CLIENT
	bool "Client api"
	help
	Component framework client interface. This allows to create component
	framework clients.

config CFW_SERVICE
	bool "Service api"
	select LIST
	help
	Component framework service interface. This allows to create component
	framework services.
```

## framework/src/services/Kconfig
```kconfig
menu "Analog Digital Converter"

config SERVICES_QRK_SE_ADC
	bool "Client"
	select CFW

config SERVICES_QRK_SE_ADC_IMPL
	bool "Server"
	depends on HAS_SS_ADC
	select CFW
	select SS_ADC

endmenu

menu "GPIO"

config SERVICES_QRK_SE_GPIO
	bool "Quark_SE GPIO service client"
	select CFW

config SERVICES_QRK_SE_GPIO_IMPL
	bool "Quark_SE GPIO service server"
	depends on HAS_GPIO
	select CFW
	select SOC_GPIO if HAS_GPIO_SOC
	select SS_GPIO if HAS_GPIO_SS

endmenu

menu "Sensors"

config SERVICES_SENSOR
	bool "Client"
	select CFW

config SERVICES_SENSOR_IMPL
	bool "Server"
	depends on HAS_BMI160
	select CFW
	select BMI160
	select SENSOR_CORE

config SERVICES_SENSOR_PROXY
	bool "Client Proxy"

config SENSOR_CORE
	bool

if SENSOR_CORE

menu "Sensor Core"

choice
	prompt "Implementation"

config OPEN_CORE
	bool "Open"
	select SENSOR_CORE_ALGO

config PSH_CORE
	bool "PSH"
	select SENSOR_CORE_ALGO


endchoice

config SENSOR_CORE_ALGO
	bool

if SENSOR_CORE_ALGO

menu "Algorithms"

config SENSOR_CORE_ALGO_COMMON
	bool

config SENSOR_CORE_ALGO_UDG
	bool "User Defined Gesture"
	depends on HAS_PVP
	select SENSOR_CORE_ALGO_COMMON
	select PVP_DRV

config SENSOR_CORE_ALGO_TAPPING
	bool "Tapping"
	select SENSOR_CORE_ALGO_COMMON

config SENSOR_CORE_ALGO_SIMPLEGES
	bool "Simple Gesture"
	select SENSOR_CORE_ALGO_COMMON

config SENSOR_CORE_ALGO_STEPCOUNTER_ACTIVITY
	bool "Step counter and Activity classification"
	select SENSOR_CORE_ALGO_COMMON

config SENSOR_CORE_ALGO_BIKE
    bool "Biking"
    depends on SENSOR_CORE_ALGO_STEPCOUNTER_ACTIVITY
    select SENSOR_CORE_ALGO_COMMON

config SENSOR_CORE_ALGO_DEMO
	bool "Algo Demo"
	select SENSOR_CORE_ALGO_COMMON
endmenu

endif

endmenu

endif

endmenu




if QUARK_SE_QUARK

menu "Storage"

config SERVICES_QRK_SE_STORAGE
	bool "Client"
	select CFW

config SERVICES_QRK_SE_STORAGE_IMPL
	bool "Server"
	depends on HAS_FLASH
	select CFW
	select SOC_FLASH if HAS_FLASH_SOC
	select SPI_FLASH if HAS_SPI_FLASH

endmenu

menu "Properties"

config SERVICES_QRK_SE_PROPERTIES
	bool "Client"
	select CFW

config SERVICES_QRK_SE_PROPERTIES_IMPL
	bool "Server"
	select CFW
	select SERVICES_QRK_SE_STORAGE

endmenu

endif
```

## projects/arduino101/arc/defconfig
```kconfig
CONFIG_BOARD_ARDUINO101=y
CONFIG_OS_ZEPHYR=y
CONFIG_LOG_MULTI_CPU_SUPPORT=y
CONFIG_LOG_SLAVE=y
CONFIG_LOG_CBUFFER=y
CONFIG_WORKQUEUE=y
CONFIG_PM_PUPDR=y
CONFIG_CFW=y
CONFIG_MEM_POOL_DEF_PATH="$(PROJECT_PATH)/arc/"
```

## projects/arduino101/quark/defconfig
```kconfig
CONFIG_BOARD_ARDUINO101=y
CONFIG_QUARK=y
CONFIG_OS_ZEPHYR=y
CONFIG_MEM_POOL_DEF_PATH="$(PROJECT_PATH)/quark/"
CONFIG_OS_ZEPHYR_MICROKERNEL=y
CONFIG_OS_ZEPHYR_MDEF="usb_app.mdef"
CONFIG_LOG_MULTI_CPU_SUPPORT=y
CONFIG_LOG_CBUFFER=y
CONFIG_LOG_CBUFFER_SIZE=2048
CONFIG_SOC_COMPARATOR=y
CONFIG_SOC_GPIO=y
CONFIG_SOC_GPIO_32=y
CONFIG_SOC_GPIO_AON=y
CONFIG_SERVICES_QRK_SE_GPIO_IMPL=y
CONFIG_SPI_FLASH_W25Q16DV=y
CONFIG_USB_PM=y
CONFIG_PM_PUPDR=y
CONFIG_USB_ACM=y
CONFIG_CFW=y
CONFIG_CFW_PROXY=y
CONFIG_ARDUINO101_NO_DEBUG_PRINTS=y
CONFIG_ZEPHYR_CONF_FILE="$(PROJECT_PATH)/prj-arduino101.conf"
CONFIG_FAT_FS=y
```

## projects/arduino101/variant_configs/arc/factorytests_defconfig
```kconfig
CONFIG_OS_ZEPHYR = y
CONFIG_QUARK_SE = y
CONFIG_ARC = y
CONFIG_CFW_PROXY = y
CONFIG_INFRA = y
CONFIG_IPC = y
CONFIG_TCMD = y
CONFIG_TCMD_ASYNC = y
CONFIG_TCMD_SLAVE = y
CONFIG_CFW_SERVICES_TEST = y
CONFIG_LOG_CBUFFER = y
CONFIG_LOG_CBUFFER_SIZE = 1024
CONFIG_WORKQUEUE = y
CONFIG_SBA = y
CONFIG_GPIO = y
CONFIG_SOC_GPIO_AON = y
CONFIG_SERVICES_QRK_SE_GPIO_IMPL = y
CONFIG_SERVICES_QRK_SE_ADC_IMPL = y
CONFIG_SOC_GPIO = y
CONFIG_BMI160 = y
CONFIG_SENSOR_CORE = y
CONFIG_PSH_CORE = y
#CONFIG_OPEN_CORE = y
CONFIG_SERVICES_SENSOR_IMPL = y
CONFIG_SENSOR_CORE_ALGO = y
CONFIG_SENSOR_CORE_ALGO_COMMON = y
CONFIG_SENSOR_CORE_ALGO_UDG = y
CONFIG_PVP_DRV = y
CONFIG_PANIC = y
CONFIG_PM = y
CONFIG_PM_PUPDR = y
CONFIG_USB_PM = y
CONFIG_SENSOR_CORE_ALGO_TAPPING = y
CONFIG_SENSOR_CORE_ALGO_SIMPLEGES = y
CONFIG_SENSOR_CORE_ALGO_STEPCOUNTER_ACTIVITY = y
#CONFIG_SENSOR_CORE_ALGO_BIKE = y
#CONFIG_SENSOR_CORE_ALGO_SLEEP = y
CONFIG_EXTERNAL_DIRECTORIES =  $(T)/firmware/packages/intel/sensors/algo/activity_algos/src/ $(T)/firmware/packages/intel/sensors/arcdrivers/ $(T)/firmware/devices/quark_se_arduino101/src/
CONFIG_SS_ADC = y
CONFIG_SS_GPIO = y
CONFIG_SS_SPI = y
CONFIG_SS_I2C = y
```

## projects/arduino101/variant_configs/quark/factorytests_defconfig
```kconfig
CONFIG_OS_ZEPHYR = y
CONFIG_OS_ZEPHYR_MDEF = minimal.mdef
CONFIG_EXTERNAL_DIRECTORIES = $(T)/arduino101_firmware/devices/quark_se_arduino101/src/
CONFIG_QUARK_SE = y
CONFIG_QUARK = y
CONFIG_CFW_MASTER = y
CONFIG_OS_ZEPHYR_MICROKERNEL = y
CONFIG_INFRA = y
CONFIG_IPC = y
CONFIG_PANIC = y
CONFIG_LOG_CBUFFER = y
CONFIG_LOG_CBUFFER_SIZE = 2048
CONFIG_WORKQUEUE = y
CONFIG_SBA = y
CONFIG_PM = y
```
